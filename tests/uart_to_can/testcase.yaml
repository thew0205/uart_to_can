## tests/uart_to_can/testcase.yaml
```yaml
tests:
  # section.subsection
  uart_to_can.tests:
    build_only: false
    platform_allow:
      - native_sim
    integration_platforms:
      - native_sim
    tags: test_framework
```

## tests/uart_to_can_core_utility/testcase.yaml
```yaml
tests:
  # section.subsection
  uart_to_can_core_utility.tests:
    build_only: false
    platform_allow:
      - native_sim
    integration_platforms:
      - native_sim
    tags: test_framework
```
